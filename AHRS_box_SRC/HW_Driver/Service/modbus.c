
#include "stm32f10x.h"
#include "eeprom.h"

#define CPU_CLK  72
/* ----------------------- Defines ------------------------------------------*/
#define MB_SER_PDU_SIZE_MIN     4       /*!< Minimum size of a Modbus RTU frame. */
#define MB_SER_PDU_SIZE_MAX     256     /*!< Maximum size of a Modbus RTU frame. */
#define MB_SER_PDU_SIZE_CRC     2       /*!< Size of CRC field in PDU. */
#define MB_SER_PDU_ADDR_OFF     0       /*!< Offset of slave address in Ser-PDU. */
#define MB_SER_PDU_PDU_OFF      1       /*!< Offset of Modbus-PDU in Ser-PDU. */

/* ----------------------- Defines ------------------------------------------*/
#define MB_ADDRESS_BROADCAST    ( 0 )   /*! Modbus broadcast address. */
#define MB_ADDRESS_MIN          ( 1 )   /*! Smallest possible slave address. */
#define MB_ADDRESS_MAX          ( 247 ) /*! Biggest possible slave address. */
#define MB_FUNC_NONE                          (  0 )
#define MB_FUNC_READ_COILS                    (  1 )
#define MB_FUNC_READ_DISCRETE_INPUTS          (  2 )
#define MB_FUNC_WRITE_SINGLE_COIL             (  5 )
#define MB_FUNC_WRITE_MULTIPLE_COILS          ( 15 )
#define MB_FUNC_READ_HOLDING_REGISTER         (  3 )
#define MB_FUNC_READ_INPUT_REGISTER           (  4 )
#define MB_FUNC_WRITE_REGISTER                (  6 )
#define MB_FUNC_WRITE_MULTIPLE_REGISTERS      ( 16 )
#define MB_FUNC_READWRITE_MULTIPLE_REGISTERS  ( 23 )
#define MB_FUNC_DIAG_READ_EXCEPTION           (  7 )
#define MB_FUNC_DIAG_DIAGNOSTIC               (  8 )
#define MB_FUNC_DIAG_GET_COM_EVENT_CNT        ( 11 )
#define MB_FUNC_DIAG_GET_COM_EVENT_LOG        ( 12 )
#define MB_FUNC_OTHER_REPORT_SLAVEID          ( 17 )
#define MB_FUNC_ERROR                         ( 128 )

#define IS_VALID_ADD      ((ucRTUBuf[MB_SER_PDU_ADDR_OFF] == ucMBAddress) ||      \
                           (ucRTUBuf[MB_SER_PDU_ADDR_OFF] == MB_ADDRESS_BROADCAST))
#define IS_NOT_BROADCAST  (ucRTUBuf[MB_SER_PDU_ADDR_OFF] != MB_ADDRESS_BROADCAST)


/* ----------------------- Type definitions ---------------------------------*/
typedef enum
{
    STATE_RX_INIT,              /*!< Receiver is in initial state. */
    STATE_RX_IDLE,              /*!< Receiver is in idle state. */
    STATE_RX_RCV,               /*!< Frame is beeing received. */
    STATE_RX_ERROR              /*!< If the frame is invalid. */
} eMBRcvState;

typedef enum
{
    STATE_TX_IDLE,              /*!< Transmitter is in idle state. */
    STATE_TX_XMIT               /*!< Transmitter is in transfer state. */
} eMBSndState;
extern volatile eMBRcvState eRcvState;

static uint8_t    ucMBAddress;
volatile eMBRcvState eRcvState;
volatile uint8_t  ucRTUBuf[MB_SER_PDU_SIZE_MAX];

static volatile uint16_t usRcvBufferPos;

static const uint8_t aucCRCHi[] = {
    0x00, 0xC1, 0x81, 0x40, 0x01, 0xC0, 0x80, 0x41, 0x01, 0xC0, 0x80, 0x41,
    0x00, 0xC1, 0x81, 0x40, 0x01, 0xC0, 0x80, 0x41, 0x00, 0xC1, 0x81, 0x40,
    0x00, 0xC1, 0x81, 0x40, 0x01, 0xC0, 0x80, 0x41, 0x01, 0xC0, 0x80, 0x41,
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    0x00, 0xC1, 0x81, 0x40
};

static const uint8_t aucCRCLo[] = {
    0x00, 0xC0, 0xC1, 0x01, 0xC3, 0x03, 0x02, 0xC2, 0xC6, 0x06, 0x07, 0xC7,
    0x05, 0xC5, 0xC4, 0x04, 0xCC, 0x0C, 0x0D, 0xCD, 0x0F, 0xCF, 0xCE, 0x0E,
    0x0A, 0xCA, 0xCB, 0x0B, 0xC9, 0x09, 0x08, 0xC8, 0xD8, 0x18, 0x19, 0xD9,
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    0x41, 0x81, 0x80, 0x40
};
//校验CRC
uint16_t usMBCRC16( uint8_t * pucFrame, uint16_t usLen )
{
    uint8_t           ucCRCHi = 0xFF;
    uint8_t           ucCRCLo = 0xFF;
    uint16_t          iIndex;

    while( usLen-- ){
        iIndex = ucCRCLo ^ *( pucFrame++ );
        ucCRCLo = ( uint8_t )( ucCRCHi ^ aucCRCHi[iIndex] );
        ucCRCHi = aucCRCLo[iIndex];
    }
    return ( uint16_t )( ucCRCHi << 8 | ucCRCLo );
}

//从波特率计算出定时器溢出时间
void Mod_BusInit(uint8_t ucSlaveAddress, uint32_t ulBaudRate)
{
    TIM_TimeBaseInitTypeDef  TIM_TimeBaseStructure;
  	NVIC_InitTypeDef NVIC_InitStructure;
    uint16_t           usTimerT35_50us;     //一个单位是50uS
    if( ( ucSlaveAddress == MB_ADDRESS_BROADCAST ) ||
        ( ucSlaveAddress < MB_ADDRESS_MIN        ) || 
        ( ucSlaveAddress > MB_ADDRESS_MAX        ) ){
      return;
    }
    ucMBAddress = ucSlaveAddress;
    
    if( ulBaudRate > 19200 ){
        usTimerT35_50us = 35;    
    }
    else{
        usTimerT35_50us = ( 7UL * 220000UL ) / ( 2UL * ulBaudRate );
    }
    
	RCC_APB1PeriphClockCmd(RCC_APB1Periph_TIM2 | RCC_APB1Periph_TIM3, ENABLE);
	NVIC_InitStructure.NVIC_IRQChannel = TIM2_IRQn;
    NVIC_InitStructure.NVIC_IRQChannelPreemptionPriority = 1;
    NVIC_InitStructure.NVIC_IRQChannelSubPriority = 2;
    NVIC_InitStructure.NVIC_IRQChannelCmd = ENABLE;
    NVIC_Init(&NVIC_InitStructure);

	TIM_TimeBaseStructure.TIM_Period = CPU_CLK - 1;               //自动重装数据值 一个单位是1us
    TIM_TimeBaseStructure.TIM_Prescaler = usTimerT35_50us * 50;	//预分频值       一个单位是50uS
    TIM_TimeBaseStructure.TIM_ClockDivision = TIM_CKD_DIV1;		    //时钟分割
    TIM_TimeBaseStructure.TIM_CounterMode = TIM_CounterMode_Up;	  //TIM向上计数模式
    TIM_TimeBaseInit(TIM2, &TIM_TimeBaseStructure);
	TIM_ClearFlag(TIM2, TIM_FLAG_Update);
	TIM_ITConfig(TIM2,TIM_IT_Update,ENABLE);
	TIM2->CR1 &=~0x01;    //关定时器2
    eRcvState = STATE_RX_INIT;
}

static void Tim2_restart(void){
	TIM2->CNT = 0;
	TIM2->CR1 |= 0x01;    //使能定时器2
}

//接收到一个字节的数据。进行解码
void Mod_bus_Receive(uint8_t ucByte){
switch ( eRcvState ){
    case STATE_RX_INIT:
    case STATE_RX_ERROR:
        Tim2_restart(  );
        break;
    case STATE_RX_IDLE:
        usRcvBufferPos = 0;
        ucRTUBuf[usRcvBufferPos++] = ucByte;
        eRcvState = STATE_RX_RCV;
        Tim2_restart(  );
        break;
    case STATE_RX_RCV:
        if( usRcvBufferPos < MB_SER_PDU_SIZE_MAX ){
            ucRTUBuf[usRcvBufferPos++] = ucByte;
        }
        else{
            eRcvState = STATE_RX_ERROR;
        }
        Tim2_restart(  );
        break;      
    }

}

//发送modbus数据。
extern volatile int16_t Pdata[12];
extern unsigned char USART1WriteDataToBuffer(unsigned char *buffer,unsigned char count);
u8 modbus_txbuf[100];
void Send_Back_Modbus(u16 base,u16 len){
	u16 index = 0,i;
	uint16_t usCRC16;
	if(base >12) return;
	if((len+base) >12)return;
	modbus_txbuf[index++] = ucMBAddress;
	modbus_txbuf[index++] = 0x04;
	modbus_txbuf[index++] = len*2;
	for(i = 0;i<len;i++){
	modbus_txbuf[index++] = Pdata[base+i]>>8;
	modbus_txbuf[index++] = Pdata[base+i];
	}
	usCRC16 = usMBCRC16( ( uint8_t * ) modbus_txbuf, index );
	modbus_txbuf[index++] = usCRC16;
	modbus_txbuf[index++] = usCRC16>>8;
    USART1WriteDataToBuffer(&modbus_txbuf[0],index);//发送数据
}

//对命令进行回应
void Mod_bus_run(void){
	if(usRcvBufferPos < MB_SER_PDU_SIZE_MIN)                        //最小桢判断
        return;
      if(usMBCRC16((uint8_t *)ucRTUBuf, usRcvBufferPos ) != 0)          //CRC判断
        return;
		if(IS_VALID_ADD){
		if(ucRTUBuf[1] == 0x04)	//读取数据命令
			Send_Back_Modbus((ucRTUBuf[2]<<8)|ucRTUBuf[3],(ucRTUBuf[4]<<8)|ucRTUBuf[5]);
		}
}


void TIM2_IRQHandler(void)
{
if (TIM2->SR&0X0001)//溢出中断
	{
	if(eRcvState == STATE_RX_RCV){
		Mod_bus_run();
		}
	eRcvState = STATE_RX_IDLE;
	}
	TIM2->SR&=~(1<<0);//清除中断标志位  
	TIM2->CR1 &=~0x01;    //关定时器2
}




